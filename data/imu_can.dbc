VERSION "Created by canmatrix and CSS Electronics (www.csselectronics.com)"

NS_ :

BS_:

BU_:

BO_ 2632777600 BODY_POSITION: 8 IMU
 SG_ Roll_angle : 0|12@1+ (0.1,-180) [-180|180] "deg" GYRO
 SG_ Pitch_angle : 12|12@1+ (0.1,-180) [-180|180] "deg" GYRO
