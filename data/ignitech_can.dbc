VERSION "Created by canmatrix and CSS Electronics (www.csselectronics.com)"

NS_ :

BS_:

BU_:

BO_ 802 Ignitech_WB_2: 8 WB2
  SG_ Lambda : 16|16@1+ (0.01,0) [0|100.00] "" OXY
